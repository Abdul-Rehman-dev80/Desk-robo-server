## firmware/main/Kconfig.projbuild
```kconfig
menu "Desk Robo"

    config ROBO_WIFI_SSID
        string "WiFi SSID"
        default ""

    config ROBO_WIFI_PASSWORD
        string "WiFi password"
        default ""

    config ROBO_HOSTNAME
        string "mDNS hostname (reach the robot at <name>.local)"
        default "deskrobo"

    config ROBO_PAN_MIN_DEG
        int "Pan lower limit (degrees)"
        range 0 180
        default 10

    config ROBO_PAN_MAX_DEG
        int "Pan upper limit (degrees)"
        range 0 180
        default 170

    config ROBO_TILT_MIN_DEG
        int "Tilt lower limit (degrees)"
        range 0 180
        default 45

    config ROBO_TILT_MAX_DEG
        int "Tilt upper limit (degrees)"
        range 0 180
        default 135

    config ROBO_SERVO_SPEED_DEG_S
        int "Maximum servo speed (degrees per second)"
        range 10 600
        default 180
        help
            Servo moves are ramped to this speed. Slower ramps draw less
            current and avoid brownout resets on a weak 5 V supply.

endmenu
```

## firmware/sdkconfig.defaults
```kconfig
CONFIG_IDF_TARGET="esp32s3"

# N16R8: 16 MB QIO flash, 8 MB octal PSRAM
CONFIG_ESPTOOLPY_FLASHMODE_QIO=y
CONFIG_ESPTOOLPY_FLASHSIZE_16MB=y
CONFIG_SPIRAM=y
CONFIG_SPIRAM_MODE_OCT=y
CONFIG_SPIRAM_SPEED_80M=y
CONFIG_SPIRAM_USE_MALLOC=y

CONFIG_PARTITION_TABLE_CUSTOM=y
CONFIG_PARTITION_TABLE_CUSTOM_FILENAME="partitions.csv"

CONFIG_ESP_DEFAULT_CPU_FREQ_MHZ_240=y
CONFIG_ESP32S3_DATA_CACHE_64KB=y
CONFIG_ESP32S3_DATA_CACHE_LINE_64B=y

# Camera frame buffers live in PSRAM
CONFIG_CAMERA_TASK_STACK_SIZE=4096

CONFIG_HTTPD_MAX_REQ_HDR_LEN=1024
CONFIG_FREERTOS_HZ=1000
```
